## satellite-esp/components/hannah_asset/Kconfig
```kconfig
menu "Hannah Asset Server"

    config HANNAH_ASSET_SERVER_URL
        string "Asset Server URL"
        default ""
        help
            URL des Asset-Servers ohne abschließenden Slash.
            Beispiel: https://assets.sgessinger.de

    config HANNAH_ASSET_SERVER_TOKEN
        string "Asset Server Bearer Token"
        default ""
        help
            Bearer-Token für den Asset-Server.
            Wird als CI-Variable gesetzt und in sdkconfig.defaults.ci geschrieben.

endmenu
```

## satellite-esp/components/hannah_ble/Kconfig
```kconfig
menu "Hannah BLE-Scanner"
    config HANNAH_BLE_ENABLED
        bool "BLE-Scanner aktivieren"
        default y
        help
            Passiver BLE-Scanner für Indoor-Lokalisierung. Scannt BLE-Advertisements
            von konfigurierten MAC-Adressen (Watchlist) und meldet RSSI per MQTT: hannah/satellite/{device}/ble/report

    config HANNAH_BLE_REPORT_INTERVAL_MS
        int "Minimales Intervall zwischen RSSI-Reports pro MAC (ms)"
        default 5000
        help
            Verhindert MQTT-Flooding. Ein Gerät wird höchstens alle N ms
            gemeldet, auch wenn es häufiger gesehen wird.

    config HANNAH_BLE_WATCHLIST_MAX
        int "Maximale Anzahl überwachter MAC-Adressen"
        default 16
        range 1 32

endmenu
```

## satellite-esp/components/hannah_config/Kconfig
```kconfig
menu "Hannah OTA"

    config HANNAH_OTA_URL
        string "Update Server URL"
        default "https://hannah-update.sgessinger.de"
        help
            URL des Hannah Satellite Update Servers.
            Kann im Webinterface überschrieben werden.

    config HANNAH_OTA_TOKEN
        string "Download Token"
        default ""
        help
            Bearer-Token für den Download vom Update Server.
            Wird von der CI automatisch eingetragen — nie manuell setzen.

    config HANNAH_OTA_CHANNEL
        string "Update Channel"
        default ""
        help
            OTA-Channel: leer = stable, "dev" = Entwicklungs-Channel.
            Devkit-Builds setzen diesen Wert auf "dev".

endmenu
```

## satellite-esp/components/hannah_led/Kconfig
```kconfig
menu "Hannah LED"

    config HANNAH_LED_GPIO
        int "SK6812 / WS2812B Data GPIO"
        default 5
        help
            GPIO für den SK6812MINI-E-Ring (RMT-Peripheral).
            PCB Rev.3: GPIO5 → SN74AHCT125 Level-Shifter → LED-Ring.
            DevKitC-1 Breadboard: GPIO48.

    config HANNAH_LED_COUNT
        int "Anzahl LEDs im Ring"
        default 12
        range 1 64

    config HANNAH_STATUS_LED_ENABLED
        bool "Status-LED aktivieren"
        default y
        help
            Einfache GPIO-LED die leuchtet wenn der ESP läuft.

    config HANNAH_STATUS_LED_GPIO
        int "Status-LED GPIO"
        default 18
        depends on HANNAH_STATUS_LED_ENABLED
        help
            PCB Rev.4: GPIO18.

endmenu
```

## satellite-esp/components/hannah_ota/Kconfig
```kconfig
menu "Hannah OTA-Check"

    config HANNAH_OTA_POLL_INTERVAL_S
        int "Prüfintervall in Sekunden"
        default 21600
        help
            Wie oft auf neue Firmware geprüft wird (Standard: 21600 = 6 Stunden).


endmenu
```

## satellite-esp/components/hannah_sd/Kconfig
```kconfig
menu "Hannah SD-Karte"

    config HANNAH_SD_ENABLED
        bool "SD-Karten-Support aktivieren"
        default n
        help
            SPI-basierter Micro-SD-Karten-Slot. Nur auf PCBs mit SD-Hardware aktivieren.

    config HANNAH_SD_CS_GPIO
        int "SPI Chip-Select GPIO"
        default 4
        depends on HANNAH_SD_ENABLED

    config HANNAH_SD_MOSI_GPIO
        int "SPI MOSI GPIO"
        default 5
        depends on HANNAH_SD_ENABLED

    config HANNAH_SD_CLK_GPIO
        int "SPI CLK GPIO"
        default 6
        depends on HANNAH_SD_ENABLED

    config HANNAH_SD_MISO_GPIO
        int "SPI MISO GPIO"
        default 7
        depends on HANNAH_SD_ENABLED

endmenu
```

## satellite-esp/components/hannah_sensors/Kconfig
```kconfig
menu "Hannah Sensors"

    config HANNAH_SENSOR_SDA_GPIO
        int "I2C SDA GPIO"
        default 8

    config HANNAH_SENSOR_SCL_GPIO
        int "I2C SCL GPIO"
        default 9

    choice HANNAH_SENSOR_TYPE
        prompt "Sensor-Kombination"
        default HANNAH_SENSOR_TYPE_BME680
        help
            BME680 für PCB Rev.3 (Temp/Feuchte/Druck/VOC).
            BMP280+AHT20 für DevKit/Breadboard (Temp/Druck + Feuchte separat).

        config HANNAH_SENSOR_TYPE_BME680
            bool "BME680 (PCB Rev.3)"

        config HANNAH_SENSOR_TYPE_BMP280_AHT20
            bool "BMP280 + AHT20 (DevKit)"
    endchoice

    config HANNAH_SENSOR_BME680_ADDR
        int "BME680 I2C-Adresse (dezimal)"
        default 119
        depends on HANNAH_SENSOR_TYPE_BME680
        help
            0x76 (118) wenn SDO=GND, 0x77 (119) wenn SDO=VDD.

    config HANNAH_SENSOR_BMP280_ADDR
        int "BMP280 I2C-Adresse (dezimal)"
        default 118
        depends on HANNAH_SENSOR_TYPE_BMP280_AHT20
        help
            0x76 (118) wenn SDO=GND, 0x77 (119) wenn SDO=VDD.

endmenu
```

## satellite-esp/components/hannah_webserver/Kconfig
```kconfig
menu "Hannah NVS Update API"

    config HANNAH_NVS_TOKEN
        string "NVS Update Bearer Token"
        default ""
        help
            Bearer-Token für POST /nvs (Refs #36). Eigener, von ota_token
            getrennter Token — ota_token ist nicht zwingend über die Flotte
            identisch, kann also nicht als gemeinsames Geheimnis dienen.
            Leer = Endpoint lehnt alle Requests ab (fail closed).

endmenu
```

## satellite-esp/sdkconfig.defaults.devkit
```kconfig
# Hannah Satellite — ESP32-S3 DevKitC-1 (Breadboard)
# Mikrofon: INMP441 × 2 (I2S), Speaker: MAX98357A, LED: onboard WS2812B

# Mikrofon — I2S (INMP441)
CONFIG_HANNAH_MIC_TYPE_I2S=y
CONFIG_HANNAH_MIC_I2S_PORT=0
CONFIG_HANNAH_MIC_BCK_GPIO=4
CONFIG_HANNAH_MIC_WS_GPIO=5
CONFIG_HANNAH_MIC_DATA_GPIO=6

# Speaker (MAX98357A)
CONFIG_HANNAH_SPK_BCK_GPIO=15
CONFIG_HANNAH_SPK_WS_GPIO=16
CONFIG_HANNAH_SPK_DATA_GPIO=7

# LED — onboard single WS2812B (DevKitC-1: GPIO48)
CONFIG_HANNAH_LED_GPIO=48
CONFIG_HANNAH_LED_COUNT=1

# Tasten — GPIO0 = BOOT-Taster auf dem DevKit als PTT
CONFIG_HANNAH_PTT_GPIO=0
CONFIG_HANNAH_MUTE_GPIO=11

# Kein Hardware-Mute-Transistor auf dem Breadboard — beliebiger freier GPIO
CONFIG_HANNAH_MUTE_HW_GPIO=2

# Sensoren — BMP280 + AHT20
CONFIG_HANNAH_SENSOR_TYPE_BMP280_AHT20=y
CONFIG_HANNAH_SENSOR_SDA_GPIO=8
CONFIG_HANNAH_SENSOR_SCL_GPIO=9
CONFIG_HANNAH_SENSOR_BMP280_ADDR=119

# OTA — kürzeres Intervall + Dev-Channel zum Testen
CONFIG_HANNAH_OTA_POLL_INTERVAL_S=300
CONFIG_HANNAH_OTA_CHANNEL="satellite-esp-dev"
```

## satellite-esp/sdkconfig.defaults.rev2
```kconfig
# Hannah Satellite — PCB Rev.2 (114mm, ESP32-S3-WROOM-1-N16R8)
# Mikrofon: 2× SPH0641LU4H-1 (PDM), Speaker: MAX98357A, LED: externer Ring (IO5)
# Sensoren: BMP280 + AHT20

# Mikrofon — PDM (2× SPH0641LU4H-1)
CONFIG_HANNAH_MIC_TYPE_PDM=y
CONFIG_HANNAH_MIC_I2S_PORT=0
CONFIG_HANNAH_MIC_CLK_GPIO=39
CONFIG_HANNAH_MIC_DATA_GPIO=40

# Speaker (MAX98357A)
CONFIG_HANNAH_SPK_BCK_GPIO=47
CONFIG_HANNAH_SPK_WS_GPIO=38
CONFIG_HANNAH_SPK_DATA_GPIO=21

# LED-Ring (extern, 12× WS2812B, Datenleitung IO5)
CONFIG_HANNAH_LED_GPIO=5
CONFIG_HANNAH_LED_COUNT=12

# Tasten (active-low, interner Pull-up)
CONFIG_HANNAH_PTT_GPIO=12
CONFIG_HANNAH_MUTE_GPIO=11
CONFIG_HANNAH_MUTE_HW_GPIO=2

# Sensoren — BMP280 + AHT20
CONFIG_HANNAH_SENSOR_TYPE_BMP280_AHT20=y
CONFIG_HANNAH_SENSOR_SDA_GPIO=8
CONFIG_HANNAH_SENSOR_SCL_GPIO=9
CONFIG_HANNAH_SENSOR_BMP280_ADDR=118

# OTA — Dev-Channel (Rev.2 ist Testplatine)
CONFIG_HANNAH_OTA_POLL_INTERVAL_S=300
CONFIG_HANNAH_OTA_CHANNEL="satellite-esp-dev"
```

## satellite-esp/sdkconfig.defaults.rev3
```kconfig
# Hannah Satellite — PCB Rev.3 (88 mm, ESP32-S3-WROOM-1-N16R8)
# Alle Pin-Belegungen gemäß satellite-esp/hardware/Phase2/GPIO_Map.md

# Mikrofon — PDM (2× SPH0641LU4H-1)
CONFIG_HANNAH_MIC_TYPE_PDM=y
CONFIG_HANNAH_MIC_I2S_PORT=0
CONFIG_HANNAH_MIC_CLK_GPIO=39
CONFIG_HANNAH_MIC_DATA_GPIO=40
CONFIG_HANNAH_MUTE_HW_GPIO=10

# Speaker (MAX98357A)
CONFIG_HANNAH_SPK_BCK_GPIO=47
CONFIG_HANNAH_SPK_WS_GPIO=38
CONFIG_HANNAH_SPK_DATA_GPIO=21

# LED-Ring (24× SK6812MINI-E, via SN74AHCT125 Level-Shifter)
CONFIG_HANNAH_LED_GPIO=5
CONFIG_HANNAH_LED_COUNT=24

# Tasten (active-low, interner Pull-up)
CONFIG_HANNAH_MUTE_GPIO=11
CONFIG_HANNAH_PTT_GPIO=12
CONFIG_HANNAH_VOL_UP_GPIO=13
CONFIG_HANNAH_VOL_DOWN_GPIO=14

# Sensoren — BME680
CONFIG_HANNAH_SENSOR_TYPE_BME680=y
CONFIG_HANNAH_SENSOR_SDA_GPIO=8
CONFIG_HANNAH_SENSOR_SCL_GPIO=9
CONFIG_HANNAH_SENSOR_BME680_ADDR=119
```
